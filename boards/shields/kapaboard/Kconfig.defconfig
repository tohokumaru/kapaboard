## boards/shields/kapaboard/Kconfig.defconfig
```kconfig
if SHIELD_KAPABOARD_RIGHT

config ZMK_KEYBOARD_NAME
    default "kapaboard"

endif

if SHIELD_KAPABOARD_LEFT || SHIELD_KAPABOARD_RIGHT

config ZMK_SPLIT
    default y

endif
```

## boards/shields/kapaboard/Kconfig.shield
```kconfig
config SHIELD_KAPABOARD_LEFT
    def_bool $(shields_list_contains,kapaboard_left)
config SHIELD_KAPABOARD_RIGHT
    def_bool $(shields_list_contains,kapaboard_right)
```
